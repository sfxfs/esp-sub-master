## components/aht30/Kconfig.projbuild
```kconfig
menu "AHT30 Driver Configuration"
    depends on SOC_I2C_SUPPORTED

    config SUB_AHT30_IIC_PORT
        int "Set AHT30 IIC port"
        range 0 1
        default 0

    config SUB_AHT30_IIC_ADDRESS
        hex "Set AHT30 IIC address"
        range 0 0x7f # 7bit address
        default 0x3B

    config SUB_AHT30_IIC_FREQUENCY
        int "Set AHT30 IIC freq"
        range 100000 400000
        default 400000

    config SUB_AHT30_IIC_TIMEOUT
        int "Set AHT30 IIC timeout"
        default 50
        help
            Wait timeout, in ms. Note: -1 means wait forever.

endmenu
```

## components/dshot/Kconfig.projbuild
```kconfig
menu "DSHOT RMT Driver Configuration"
    depends on SOC_RMT_SUPPORTED

    config SUB_DSHOT_RESOLUTION
        int "Resolution of Dshot"
        default 40000000
        help
            Resolution of DSHOT, 40000000 is 40MHz.

    config SUB_DSHOT_BAUD_RATE
        int "Set Dshot baud rate"
        default 300000
        help
            Baud rate of DSHOT, 300000 is DSHOT300.

    config SUB_DSHOT_POST_DELAY_US
        int "Extra delay between each frame"
        default 50
        help
            Related to the baud rate.

endmenu
```

## components/jy901/Kconfig.projbuild
```kconfig
menu "JY901 Driver Configuration"
    depends on SOC_I2C_SUPPORTED

    config SUB_JY901_IIC_PORT
        int "Set IIC port"
        range 0 1
        default 0

    config SUB_JY901_IIC_ADDRESS
        hex "Set IIC address"
        range 0 0x7f # 7bit address
        default 0x50

    config SUB_JY901_IIC_FREQUENCY
        int "Set IIC freq"
        range 100000 2000000
        default 400000

    config SUB_JY901_IIC_TIMEOUT
        int "Set IIC timeout"
        default 50
        help
            Wait timeout, in ms. Note: -1 means wait forever.

    config SUB_JY901_ROUTINE_PER_MS
        int "Set routine period"
        range 1 1000
        default 20
        help
            The period of the routine, in ms.

endmenu
```

## components/pca9685/Kconfig.projbuild
```kconfig
menu "SUB:PCA9685"
    depends on SUB_ENABLE_I2C0 || SUB_ENABLE_I2C1

    config SUB_ENABLE_PCA9685
        bool "Enable PCA9685 peripheral"
        default y
        help
            PCA9685 is a I2C based 16-channel PWM controller.

    if SUB_ENABLE_PCA9685
        config SUB_PCA9685_IIC_PORT
            int "Set PCA9685 IIC port"
            range 0 1
            default 0

        config SUB_PCA9685_IIC_ADDRESS
            hex "Set PCA9685 IIC address"
            range 0 0x7f # 7bit address
            default 0x40

        config SUB_PCA9685_IIC_FREQUENCY
            int "Set PCA9685 IIC freq"
            range 100000 1000000
            default 400000

        config SUB_PCA9685_IIC_TIMEOUT
            int "Set PCA9685 IIC timeout"
            default 50
            help
                Wait timeout, in ms. Note: -1 means wait forever.

        config SUB_PCA9685_OE_GPIO_ENABLE
            bool "Enable PCA9685 OE GPIO"
            default n
            help
                Enable PCA9685 OE GPIO.

        if SUB_PCA9685_OE_GPIO_ENABLE
            config SUB_PCA9685_OE_GPIO_NUM
                int "Set PCA9685 OE GPIO number"
                default 18
        endif

        config SUB_PCA9685_USE_EXTERNAL_CLOCK
            bool "Use external clock"
            default y
            help
                Use external clock. If not, use internal RC clock.

        if SUB_PCA9685_USE_EXTERNAL_CLOCK
            config SUB_PCA9685_EXTERNAL_CLOCK_HZ
                int "Set PCA9685 external clock value in HZ"
                default 50000000
        endif
    endif

endmenu
```

## components/protobuf_rpc/Kconfig.projbuild
```kconfig
menu "SUB:ProtoBuf-RPC"
    menu "Interface"
        config SUB_PROTOBUF_UART_PORT
            int "Which UARTx will be used"
            default 2
            help
                The interface that used to communicate with sub-navi.

        config SUB_PROTOBUF_UART_BAUDRATE
            int "Set UART baudrate"
            default 115200
            help
                The baudrate of UARTx.

        config SUB_PROTOBUF_UART_QUEUE_SIZE
            int "Set UART queue size"
            default 20
            help
                The queue size of UARTx.

        config SUB_PROTOBUF_UART_CUSTOM_PINS
            bool "Use custom pins"
            default y
            help
                If you want to use custom pins for UARTx, enable this option.

        if SUB_PROTOBUF_UART_CUSTOM_PINS
            config SUB_PROTOBUF_UART_TX_PIN
                int "UARTx TX pin"
                default 37
                help
                    The TX pin of UARTx.

            config SUB_PROTOBUF_UART_RX_PIN
                int "UARTx RX pin"
                default 36
                help
                    The RX pin of UARTx.
        endif
    endmenu

    menu "Thruster"
        config SUB_PROTOBUF_THRUSTER0_PIN
            int "Thruster0 pin"
            default 27
            help
                The pin of thruster channel 0.

        config SUB_PROTOBUF_THRUSTER1_PIN
            int "Thruster1 pin"
            default 26
            help
                The pin of thruster channel 1.

        config SUB_PROTOBUF_THRUSTER2_PIN
            int "Thruster2 pin"
            default 25
            help
                The pin of thruster channel 2.

        config SUB_PROTOBUF_THRUSTER3_PIN
            int "Thruster3 pin"
            default 21
            help
                The pin of thruster channel 3.

        config SUB_PROTOBUF_THRUSTER4_PIN
            int "Thruster4 pin"
            default 22
            help
                The pin of thruster channel 4.

        config SUB_PROTOBUF_THRUSTER5_PIN
            int "Thruster5 pin"
            default 19
            help
                The pin of thruster channel 5.

        config SUB_PROTOBUF_THRUSTER6_PIN
            int "Thruster6 pin"
            default 23
            help
                The pin of thruster channel 6.

        config SUB_PROTOBUF_THRUSTER7_PIN
            int "Thruster7 pin"
            default 18
            help
                The pin of thruster channel 7.
    endmenu

endmenu
```

## components/sub_bus_init/Kconfig.projbuild
```kconfig
menu "SUB:Bus Interface"

    menu "Interface I2C"
        depends on SOC_I2C_SUPPORTED

        menu "I2C0 Config"
            config SUB_ENABLE_I2C0
                bool "Enable interface"
                default y

            if SUB_ENABLE_I2C0
                config SUB_I2C0_SCL_PIN
                    int "Set SCL pin num"
                    default 17

                config SUB_I2C0_SDA_PIN
                    int "Set SDA pin num"
                    default 5
            endif
        endmenu

        menu "I2C1 Config"
            config SUB_ENABLE_I2C1
                bool "Enable interface"
                default n

            if SUB_ENABLE_I2C1
                config SUB_I2C1_SCL_PIN
                    int "Set SCL pin num"
                    default 8
                    depends on SUB_ENABLE_I2C1

                config SUB_I2C1_SDA_PIN
                    int "Set SDA pin num"
                    default 9
                    depends on SUB_ENABLE_I2C1
            endif
        endmenu
    endmenu

    menu "Interface SPI"
        depends on SOC_GPSPI_SUPPORTED

        menu "SPI2 Config"
            config SUB_ENABLE_SPI2
                bool "Enable interface"
                default n

            if SUB_ENABLE_SPI2
                config SUB_SPI2_CLK_PIN
                    int "Set CLK pin num"
                    default 10

                config SUB_SPI2_MOSI_PIN
                    int "Set MOSI pin num"
                    default 11

                config SUB_SPI2_MISO_PIN
                    int "Set MISO pin num"
                    default 12
            endif
        endmenu

        menu "SPI3 Config"
            config SUB_ENABLE_SPI3
                bool "Enable interface"
                default n

            if SUB_ENABLE_SPI3
                config SUB_SPI3_CLK_PIN
                    int "Set CLK pin num"
                    default 13

                config SUB_SPI3_MOSI_PIN
                    int "Set MOSI pin num"
                    default 14

                config SUB_SPI3_MISO_PIN
                    int "Set MISO pin num"
                    default 15
            endif
        endmenu
    endmenu

endmenu
```

## components/sub_interface_init/Kconfig.projbuild
```kconfig
menu "SUB:Interface"

    menu "Interface I2C"
        menu "I2C0 Config"
            config SUB_ENABLE_I2C0
                bool "Enable interface"
                default n
                depends on SOC_I2C_SUPPORTED

            config SUB_I2C0_SCL_PIN
                int "Set SCL pin num"
                default 6
                depends on SUB_ENABLE_I2C0

            config SUB_I2C0_SDA_PIN
                int "Set SDA pin num"
                default 7
                depends on SUB_ENABLE_I2C0
        endmenu

        menu "I2C1 Config"
            config SUB_ENABLE_I2C1
                bool "Enable interface"
                default n
                depends on SOC_I2C_SUPPORTED

            config SUB_I2C1_SCL_PIN
                int "Set SCL pin num"
                default 8
                depends on SUB_ENABLE_I2C1

            config SUB_I2C1_SDA_PIN
                int "Set SDA pin num"
                default 9
                depends on SUB_ENABLE_I2C1
        endmenu
    endmenu

    menu "Interface SPI"
    endmenu

    menu "Interface UART"
    endmenu

endmenu
```
