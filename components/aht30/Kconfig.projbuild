## main/Kconfig.projbuild
```kconfig
menu "SUB::Bus Interface"

    menu "Interface I2C"
        depends on SOC_I2C_SUPPORTED

        menu "I2C0 Config"
            config SUB_ENABLE_I2C0
                bool "Enable interface"
                default y

            if SUB_ENABLE_I2C0
                config SUB_I2C0_SCL_PIN
                    int "Set SCL pin num"
                    default 37

                config SUB_I2C0_SDA_PIN
                    int "Set SDA pin num"
                    default 36
            endif
        endmenu

        menu "I2C1 Config"
            config SUB_ENABLE_I2C1
                bool "Enable interface"
                default y

            if SUB_ENABLE_I2C1
                config SUB_I2C1_SCL_PIN
                    int "Set SCL pin num"
                    default 34
                    depends on SUB_ENABLE_I2C1

                config SUB_I2C1_SDA_PIN
                    int "Set SDA pin num"
                    default 35
                    depends on SUB_ENABLE_I2C1
            endif
        endmenu
    endmenu

    menu "Interface SPI"
        depends on SOC_GPSPI_SUPPORTED

        menu "SPI2(HSPI) Config"
            config SUB_ENABLE_SPI2
                bool "Enable interface"
                default n

            if SUB_ENABLE_SPI2
                config SUB_SPI2_CLK_PIN
                    int "Set CLK pin num"
                    default 10

                config SUB_SPI2_MOSI_PIN
                    int "Set MOSI pin num"
                    default 11

                config SUB_SPI2_MISO_PIN
                    int "Set MISO pin num"
                    default 12
            endif
        endmenu

        menu "SPI3(VSPI) Config"
            config SUB_ENABLE_SPI3
                bool "Enable interface"
                default n

            if SUB_ENABLE_SPI3
                config SUB_SPI3_CLK_PIN
                    int "Set CLK pin num"
                    default 13

                config SUB_SPI3_MOSI_PIN
                    int "Set MOSI pin num"
                    default 14

                config SUB_SPI3_MISO_PIN
                    int "Set MISO pin num"
                    default 15
            endif
        endmenu
    endmenu

endmenu

menu "SUB::ProtoBuf-RPC"

    menu "Interface"
        config SUB_PROTOBUF_UART_PORT
            int "Which UARTx will be used"
            default 2
            help
                The interface that used to communicate with sub-navi.

        config SUB_PROTOBUF_UART_BAUDRATE
            int "Set UART baudrate"
            default 115200
            help
                The baudrate of UARTx.

        config SUB_PROTOBUF_UART_QUEUE_SIZE
            int "Set UART queue size"
            default 20
            help
                The queue size of UARTx.

        config SUB_PROTOBUF_UART_CUSTOM_PINS
            bool "Use custom pins"
            default y
            help
                If you want to use custom pins for UARTx, enable this option.

        if SUB_PROTOBUF_UART_CUSTOM_PINS
            config SUB_PROTOBUF_UART_TX_PIN
                int "UARTx TX pin"
                default 22
                help
                    The TX pin of UARTx.

            config SUB_PROTOBUF_UART_RX_PIN
                int "UARTx RX pin"
                default 21
                help
                    The RX pin of UARTx.
        endif
    endmenu

    menu "Thruster"
        config SUB_PROTOBUF_THRUSTERS_ENABLE
            bool "Enable thrusters"
            default y
            help
                Enable thrusters.

        config SUB_PROTOBUF_THRUSTERS_USE_ANALOG_SINGALS
            bool "Use analog signals"
            default y
            help
                Use analog signals to control thrusters.

        if SUB_PROTOBUF_THRUSTERS_USE_ANALOG_SINGALS
            config SUB_PROTOBUF_THRUSTERS_ANALOG_FREQ
                int "Set PWM frequency"
                default 1000
                help
                    The frequency of analog signals.

            config SUB_PROTOBUF_THRUSTERS_ANALOG_MID
                int "Set PWM mid value"
                default 1500
                help
                    The mid value of analog signals, means stop thruster.

            config SUB_PROTOBUF_THRUSTERS_ANALOG_MAX_OFFSET
                int "Set PWM max offset"
                default 500
                help
                    The max offset of analog signals, add to mid value is max speed.
        endif

        if SUB_PROTOBUF_THRUSTERS_ENABLE
            config SUB_PROTOBUF_THRUSTER0_PIN
                int "Thruster0 pin"
                default 25
                help
                    The pin of thruster channel 0.

            config SUB_PROTOBUF_THRUSTER1_PIN
                int "Thruster1 pin"
                default 26
                help
                    The pin of thruster channel 1.

            config SUB_PROTOBUF_THRUSTER2_PIN
                int "Thruster2 pin"
                default 27
                help
                    The pin of thruster channel 2.

            config SUB_PROTOBUF_THRUSTER3_PIN
                int "Thruster3 pin"
                default 14
                help
                    The pin of thruster channel 3.

            config SUB_PROTOBUF_THRUSTER4_PIN
                int "Thruster4 pin"
                default 12
                help
                    The pin of thruster channel 4.

            config SUB_PROTOBUF_THRUSTER5_PIN
                int "Thruster5 pin"
                default 13
                help
                    The pin of thruster channel 5.

            config SUB_PROTOBUF_THRUSTER6_PIN
                int "Thruster6 pin"
                default 15
                help
                    The pin of thruster channel 6.

            config SUB_PROTOBUF_THRUSTER7_PIN
                int "Thruster7 pin"
                default 2
                help
                    The pin of thruster channel 7.
        endif
    endmenu

    menu "PWMDevice"
        config SUB_PROTOBUF_PWM_DEVICE_ENABLE
            bool "Enable PWM device"
            default y
            help
                Enable PWM device use pca9685.

        if SUB_PROTOBUF_PWM_DEVICE_ENABLE
            config SUB_PROTOBUF_PWM_DEVICE_FERQENCY
                int "Set PWM frequency"
                default 50
                help
                    The frequency of PWM signal.
        endif
    endmenu

endmenu
```
